## meta-anthias/conf/layer.conf
```bitbake
BBPATH .= ":${LAYERDIR}"
BBFILES += "${LAYERDIR}/recipes*/*/*.bb ${LAYERDIR}/recipes*/*/*.bbappend"
BBFILE_COLLECTIONS += "anthias-hybris-layer"
BBFILE_PATTERN_anthias-hybris-layer := "^${LAYERDIR}/"
BBFILE_PRIORITY_anthias-hybris-layer = "8"
LAYERSERIES_COMPAT_anthias-hybris-layer = "whinlatter"
```

## meta-anthias/conf/machine/anthias.conf
```bitbake
#@TYPE: Machine
#@NAME: ASUS Zenwatch
#@DESCRIPTION: Machine configuration for the ASUS Zenwatch

require conf/machine/include/arm/armv7a/tune-cortexa7.inc
require conf/machine/include/hybris-watch.inc

PREFERRED_VERSION_android = "lollipop"

PREFERRED_PROVIDER_virtual/kernel = "linux-anthias"
PREFERRED_VERSION_linux = "3.10+marshmallow"

IMAGE_INSTALL += "sensorfw-hybris-hal-plugins msm-fb-refresher brcm-patchram-plus underclock asteroid-compass"
```

## meta-aurora/conf/layer.conf
```bitbake
BBPATH .= ":${LAYERDIR}"
BBFILES += "${LAYERDIR}/recipes*/*/*.bb ${LAYERDIR}/recipes*/*/*.bbappend"
BBFILE_COLLECTIONS += "aurora-hybris-layer"
BBFILE_PATTERN_aurora-hybris-layer := "^${LAYERDIR}/"
BBFILE_PRIORITY_aurora-hybris-layer = "8"
LAYERSERIES_COMPAT_aurora-hybris-layer = "walnascar"
```

## meta-aurora/conf/machine/aurora.conf
```bitbake
#@TYPE: Machine
#@NAME: Google Pixel Watch 2
#@DESCRIPTION: Machine configuration for the Pixel Watch 2

# We use an armv7 userspace for hybris compatibility
require conf/machine/include/arm/armv7a/tune-cortexa7.inc
DEFAULTTUNE = "armv7vehf-neon"
require conf/machine/include/hybris-watch.inc

# The Android side runs as a Halium LXC container, so drop meta-asteroid's
# `android-init` and meta-android's `android-system` (both added by
# hybris-watch.inc) -- we ship our own LXC bundle instead.
IMAGE_INSTALL:remove = "android-init android-system"

MACHINE_HAS_WLAN = "true"
MACHINE_HAS_SPEAKER = "true"
MACHINE_DISPLAY_ROUND = "true"

PREFERRED_PROVIDER_virtual/android-system-image = "android"
PREFERRED_VERSION_android = "armv7+pie64"

# Even though we're using an Android 13 base - the 11 headers are good enough.
PREFERRED_PROVIDER_virtual/android-headers = "android-headers-halium"
PREFERRED_VERSION_android-headers-halium = "11.0"

# Aurora's kernel is aarch64; userspace is armv7.
TUNE_PKGARCH:pn-linux-aurora = "aarch64"
PREFERRED_PROVIDER_virtual/kernel = "linux-aurora"
# Keep in sync with AURORA_KERNEL_VERSION in
# recipes-kernel/linux/linux-aurora-version.inc (machine conf can't
# require recipe-space files).
PREFERRED_VERSION_linux-aurora = "5.15.144+git%"

# Modern kernels use configfs rather than functionfs
PREFERRED_PROVIDER_android-tools-conf = "android-tools-conf-configfs"

# Various hw support packages.
IMAGE_INSTALL += "sensorfw-hybris-binder-plugins udev-droid-system bluebinder swclock-offset underclock asteroid-hrm asteroid-compass"

# qcacld picks the regulatory domain from /lib/firmware/regulatory.db at init;
# without it cfg80211 stays in world-roaming and most channels are inactive.
# wireless-regdb-static ships the upstream database without requiring CRDA.
IMAGE_INSTALL += "wireless-regdb-static"

# /vendor: aurora's stock vendor partition is a logical partition inside /super
# (/dev/mmcblk0p80, slot B). aurora-vendor-mount recreates the dm-linear
# mapping at boot, exposes it as /dev/mapper/vendor_b, and mounts it at /vendor
# so Halium HAL services (hwcomposer, vndservicemanager, BT HAL, ...) resolve
# /vendor/bin/hw/* etc.
IMAGE_INSTALL += "aurora-vendor-mount"

# Halium-13 LXC container.
IMAGE_INSTALL += "lxc aurora-lxc-android"

# Build the three flashable boot artifacts (boot.img, vendor_kernel_boot.img,
# init_boot.img) as a side-effect of `bitbake asteroid-image`. The dep is
# expressed narrowly via asteroid-image.bbappend rather than EXTRA_IMAGEDEPENDS
# here -- EXTRA_IMAGEDEPENDS would add it to initramfs-android-image too,
# which aurora-boot-images itself consumes, forming a cycle.

# Ship the out-of-tree vendor modules (qcacld WLAN, audio dlkms,
# bolero/wcd/swr/macro codecs, machine_dlkm sound card, nanohub, touch,
# cs40l26, etc.) to /lib/modules/${KREL}/vendor on the rootfs. Without this,
# only modules baked into the VKB initramfs (modules.load.aurora) are reachable
# -- post-boot audio/WLAN/sensors that aren't loaded at initramfs time can't be
# loaded at all.
IMAGE_INSTALL += "linux-aurora-modules"

# Post-rootfs auto-load: ships /etc/modules-load.d/aurora-post-rootfs.conf so
# systemd-modules-load brings up WLAN + ASoC machine/codecs + BT slim after
# pivot_root, when the linux-aurora-modules .ko's become reachable.
IMAGE_INSTALL += "aurora-modules-autoload"

# gralloc4 shim for libhybris. libhybris takes its gralloc4 path only if it can
# android_dlopen("libui_compat_layer.so") and resolve
# graphic_buffer_allocator_allocate; otherwise it falls back to
# hw_get_module("gralloc"), which on A13 finds only gralloc.default.so
# (software stub) and SIGSEGVs the compositor.
IMAGE_INSTALL += "aurora-libui-compat-layer"
```

## meta-bass/conf/layer.conf
```bitbake
BBPATH .= ":${LAYERDIR}"
BBFILES += "${LAYERDIR}/recipes*/*/*.bb ${LAYERDIR}/recipes*/*/*.bbappend"
BBFILE_COLLECTIONS += "bass-hybris-layer"
BBFILE_PATTERN_bass-hybris-layer := "^${LAYERDIR}/"
BBFILE_PRIORITY_bass-hybris-layer = "8"
LAYERSERIES_COMPAT_bass-hybris-layer = "whinlatter"
```

## meta-bass/conf/machine/bass.conf
```bitbake
#@TYPE: Machine
#@NAME: LG Watch Urbane
#@DESCRIPTION: Machine configuration for the LG Watch Urbane

require conf/machine/include/tune-cortexa7.inc
require conf/machine/include/hybris-watch.inc

MACHINE_DISPLAY_ROUND = "true"
MACHINE_HAS_WLAN = "true"

PREFERRED_VERSION_android = "lollipop"

PREFERRED_PROVIDER_virtual/kernel = "linux-bass"
PREFERRED_VERSION_linux = "3.10+lollipop"

IMAGE_INSTALL += "msm-fb-refresher brcm-patchram-plus iproute2 wpa-supplicant underclock"
```

## meta-beluga/conf/layer.conf
```bitbake
BBPATH .= ":${LAYERDIR}"
BBFILES += "${LAYERDIR}/recipes*/*/*.bb ${LAYERDIR}/recipes*/*/*.bbappend"
BBFILE_COLLECTIONS += "beluga-hybris-layer"
BBFILE_PATTERN_beluga-hybris-layer := "^${LAYERDIR}/"
BBFILE_PRIORITY_beluga-hybris-layer = "8"
LAYERSERIES_COMPAT_beluga-hybris-layer = "whinlatter"
```

## meta-beluga/conf/machine/beluga.conf
```bitbake
#@TYPE: Machine
#@NAME: OPPO Watch
#@DESCRIPTION: Machine configuration for the OPPO Watch

require conf/machine/include/arm/armv7a/tune-cortexa7.inc
DEFAULTTUNE = "armv7vehf-neon"
require conf/machine/include/hybris-watch.inc

MACHINE_HAS_WLAN = "true"
MACHINE_HAS_SPEAKER = "true"

PREFERRED_PROVIDER_virtual/android-system-image = "android"
PREFERRED_VERSION_android = "armv7+pie64"

PREFERRED_PROVIDER_virtual/kernel = "linux-beluga"
PREFERRED_VERSION_linux = "4.9+pie"

IMAGE_INSTALL += "sensorfw-hybris-binder-plugins linux-wlan-modules-beluga linux-audio-modules-beluga udev-droid-system bluebinder swclock-offset underclock asteroid-hrm asteroid-compass geoclue" 
```

## meta-catfish/conf/layer.conf
```bitbake
BBPATH .= ":${LAYERDIR}"
BBFILES += "${LAYERDIR}/recipes*/*/*.bb ${LAYERDIR}/recipes*/*/*.bbappend"
BBFILE_COLLECTIONS += "catfish-hybris-layer"
BBFILE_PATTERN_catfish-hybris-layer := "^${LAYERDIR}/"
BBFILE_PRIORITY_catfish-hybris-layer = "8"
LAYERSERIES_COMPAT_catfish-hybris-layer = "whinlatter"
```

## meta-catfish/conf/machine/catfish.conf
```bitbake
#@TYPE: Machine
#@NAME: Ticwatch Pro
#@DESCRIPTION: Machine configuration for the Ticwatch Pro

require conf/machine/include/arm/armv7a/tune-cortexa7.inc
require conf/machine/include/hybris-watch.inc

MACHINE_DISPLAY_ROUND = "true"
MACHINE_HAS_WLAN = "true"
MACHINE_HAS_SPEAKER = "true"

PREFERRED_PROVIDER_virtual/android-system-image = "android"
PREFERRED_VERSION_android = "msm8909+pie"

PREFERRED_PROVIDER_virtual/kernel = "linux-catfish"
PREFERRED_VERSION_linux = "3.18+pie"

IMAGE_INSTALL += "sensorfw-hybris-hal-plugins underclock lcd-tools udev-droid-system bluebinder asteroid-hrm asteroid-compass"
```

## meta-catfish/conf/machine/ray.conf
```bitbake
#@TYPE: Machine
#@NAME: Skagen Falster 2
#@DESCRIPTION: Machine configuration for the Skagen Falster 2

require conf/machine/include/tune-cortexa7.inc
require conf/machine/include/hybris-watch.inc

MACHINE_DISPLAY_ROUND = "true"
MACHINE_HAS_WLAN = "true"
MACHINE_HAS_SPEAKER = "true"

PREFERRED_PROVIDER_virtual/android-system-image = "android"
PREFERRED_VERSION_android = "oreo"

PREFERRED_PROVIDER_virtual/kernel = "linux-ray"
PREFERRED_VERSION_linux = "3.18+oreo"

IMAGE_INSTALL += "brcm-patchram-plus underclock wifi-enabler"
```

## meta-catfish/conf/machine/sawfish.conf
```bitbake
#@TYPE: Machine
#@NAME: Huawei Watch
#@DESCRIPTION: Machine configuration for the Huawei Watch

require conf/machine/include/tune-cortexa7.inc
require conf/machine/include/hybris-watch.inc

MACHINE_DISPLAY_ROUND = "true"
MACHINE_HAS_WLAN = "true"
MACHINE_HAS_SPEAKER = "true"

PREFERRED_PROVIDER_virtual/android-system-image = "android"
PREFERRED_VERSION_android = "oreo"

PREFERRED_PROVIDER_virtual/kernel = "linux-sawfish"
PREFERRED_VERSION_linux = "3.18+oreo"

IMAGE_INSTALL += "brcm-patchram-plus underclock asteroid-hrm asteroid-compass"
```

## meta-dory/conf/layer.conf
```bitbake
BBPATH .= ":${LAYERDIR}"
BBFILES += "${LAYERDIR}/recipes*/*/*.bb ${LAYERDIR}/recipes*/*/*.bbappend"
BBFILE_COLLECTIONS += "dory-hybris-layer"
BBFILE_PATTERN_dory-hybris-layer := "^${LAYERDIR}/"
BBFILE_PRIORITY_dory-hybris-layer = "8"
LAYERSERIES_COMPAT_dory-hybris-layer = "whinlatter"
```

## meta-dory/conf/machine/dory.conf
```bitbake
#@TYPE: Machine
#@NAME: LG G Watch
#@DESCRIPTION: Machine configuration for the LG G Watch

require conf/machine/include/arm/armv7a/tune-cortexa7.inc
DEFAULTTUNE = "armv7vehf-neon"
require conf/machine/include/hybris-watch.inc

MACHINE_NEEDS_BURN_IN_PROTECTION = "false"

PREFERRED_VERSION_android = "marshmallow"

PREFERRED_PROVIDER_virtual/kernel = "linux-dory"
PREFERRED_VERSION_linux = "3.10+marshmallow"

IMAGE_INSTALL += "sensorfw-hybris-hal-plugins msm-fb-refresher brcm-patchram-plus bluetooth-rfkill-event underclock asteroid-compass"
```

## meta-emulator/conf/layer.conf
```bitbake
BBPATH .= ":${LAYERDIR}"
BBFILES += "${LAYERDIR}/recipes*/*/*.bb ${LAYERDIR}/recipes*/*/*.bbappend"
BBFILES += "${LAYERDIR}/recipes*/*/*/*.bb ${LAYERDIR}/recipes*/*/*/*.bbappend"
BBFILE_COLLECTIONS += "emulator-layer"
BBFILE_PATTERN_emulator-layer := "^${LAYERDIR}/"
BBFILE_PRIORITY_emulator-layer = "8"
LAYERSERIES_COMPAT_emulator-layer = "whinlatter"
```

## meta-emulator/conf/machine/emulator.conf
```bitbake
#@TYPE: Machine
#@NAME: emulator
#@DESCRIPTION: Machine configuration for the Qemu-based emulator.

require conf/machine/qemux86.conf
# So we can re-use any qemux86-specific overrides in openembedded layers
MACHINEOVERRIDES:append = " qemuall: qemux86:"

MACHINE_FEATURES:append = " alsa ext2 "

IMAGE_FSTYPES:append = " ext4 "
IMAGE_ROOTFS_ALIGNMENT = "4"

MACHINE_DISPLAY_ROUND = "false"
MACHINE_HAS_WLAN = "false"
MACHINE_HAS_SPEAKER = "true"
MACHINE_HAS_MICROPHONE = "false"

KMACHINE = "qemux86"
PREFERRED_PROVIDER_virtual/kernel = "linux-yocto"
MACHINE_ESSENTIAL_EXTRA_RDEPENDS:append = " kernel-modules "
MACHINE_ESSENTIAL_EXTRA_RECOMMENDS:append = " kernel-modules "
```

## meta-hoki/conf/layer.conf
```bitbake
BBPATH .= ":${LAYERDIR}"
BBFILES += "${LAYERDIR}/recipes*/*/*.bb ${LAYERDIR}/recipes*/*/*.bbappend"
BBFILE_COLLECTIONS += "hoki-hybris-layer"
BBFILE_PATTERN_hoki-hybris-layer := "^${LAYERDIR}/"
BBFILE_PRIORITY_hoki-hybris-layer = "8"
LAYERSERIES_COMPAT_hoki-hybris-layer = "whinlatter"
```

## meta-hoki/conf/machine/hoki.conf
```bitbake
#@TYPE: Machine
#@NAME: Fossil Gen 6 platform
#@DESCRIPTION: Machine configuration for the Fossil Gen 6 platform

require conf/machine/include/arm/armv7a/tune-cortexa7.inc
DEFAULTTUNE = "armv7vehf-neon"
require conf/machine/include/hybris-watch.inc

MACHINE_DISPLAY_ROUND = "true"

PREFERRED_PROVIDER_virtual/android-system-image = "android"
PREFERRED_VERSION_android = "armv7+pie64"

PREFERRED_PROVIDER_virtual/kernel = "linux-hoki"
PREFERRED_VERSION_linux = "4.14+pie"

IMAGE_INSTALL += "sensorfw-hybris-binder-plugins android-system-data udev-droid-system bluebinder swclock-offset underclock linux-audio-modules-hoki qrtr"
```

## meta-koi/conf/layer.conf
```bitbake
BBPATH .= ":${LAYERDIR}"
BBFILES += "${LAYERDIR}/recipes*/*/*.bb ${LAYERDIR}/recipes*/*/*.bbappend"
BBFILE_COLLECTIONS += "koi-hybris-layer"
BBFILE_PATTERN_koi-hybris-layer := "^${LAYERDIR}/"
BBFILE_PRIORITY_koi-hybris-layer = "7"
LAYERSERIES_COMPAT_koi-hybris-layer = "kirkstone"
```

## meta-koi/conf/machine/koi.conf
```bitbake
#@TYPE: Machine
#@NAME: Casio WSD-F20
#@DESCRIPTION: Machine configuration for the Casio WSD-F20

require conf/machine/include/arm/armv7a/tune-cortexa7.inc
DEFAULTTUNE = "armv7vehf-neon"
require conf/machine/include/hybris-watch.inc

MACHINE_DISPLAY_ROUND = "true"
MACHINE_DISPLAY_FLAT_TIRE = "20"
MACHINE_NEEDS_BURN_IN_PROTECTION = "false"
MACHINE_HAS_WLAN = "true"

PREFERRED_PROVIDER_virtual/android-system-image = "android"
PREFERRED_VERSION_android = "armv7+oreo"

PREFERRED_PROVIDER_virtual/kernel = "linux-koi"
PREFERRED_VERSION_linux = "3.10+oreo"

IMAGE_INSTALL += "sensorfw-hybris-hal-plugins bluebinder iproute2 wpa-supplicant underclock asteroid-compass lcd-tools"
```

## meta-lenok/conf/layer.conf
```bitbake
BBPATH .= ":${LAYERDIR}"
BBFILES += "${LAYERDIR}/recipes*/*/*.bb ${LAYERDIR}/recipes*/*/*.bbappend"
BBFILE_COLLECTIONS += "lenok-hybris-layer"
BBFILE_PATTERN_lenok-hybris-layer := "^${LAYERDIR}/"
BBFILE_PRIORITY_lenok-hybris-layer = "8"
LAYERSERIES_COMPAT_lenok-hybris-layer = "whinlatter"
```

## meta-lenok/conf/machine/lenok.conf
```bitbake
#@TYPE: Machine
#@NAME: LG G Watch R
#@DESCRIPTION: Machine configuration for the LG G Watch R

require conf/machine/include/tune-cortexa7.inc
require conf/machine/include/hybris-watch.inc

MACHINE_DISPLAY_ROUND = "true"

PREFERRED_VERSION_android = "marshmallow"

PREFERRED_PROVIDER_virtual/kernel = "linux-lenok"
PREFERRED_VERSION_linux = "3.10+marshmallow"

IMAGE_INSTALL += "msm-fb-refresher brcm-patchram-plus underclock asteroid-hrm"
```

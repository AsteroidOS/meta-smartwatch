## meta-rubyfish/conf/machine/rubyfish.conf
```bitbake
#@TYPE: Machine
#@NAME: TicWatch Pro 3 GPS platform
#@DESCRIPTION: Machine configuration for the TicWatch Pro 3 GPS platform

require conf/machine/include/arm/armv7a/tune-cortexa7.inc
DEFAULTTUNE = "armv7vehf-neon"
require conf/machine/include/hybris-watch.inc

MACHINE_DISPLAY_ROUND = "true"

MACHINE_HAS_WLAN = "true"
MACHINE_HAS_SPEAKER = "true"

PREFERRED_PROVIDER_virtual/android-system-image = "android"
PREFERRED_VERSION_android = "armv7+pie64"

PREFERRED_PROVIDER_virtual/kernel = "linux-rubyfish"
PREFERRED_VERSION_linux = "4.9+pie"

IMAGE_INSTALL += "udev-droid-system bluebinder swclock-offset underclock sensorfw-hybris-hal-plugins asteroid-hrm"
```

## meta-sawfish/conf/layer.conf
```bitbake
BBPATH .= ":${LAYERDIR}"
BBFILES += "${LAYERDIR}/recipes*/*/*.bb ${LAYERDIR}/recipes*/*/*.bbappend"
BBFILE_COLLECTIONS += "sawfish-hybris-layer"
BBFILE_PATTERN_sawfish-hybris-layer := "^${LAYERDIR}/"
BBFILE_PRIORITY_sawfish-hybris-layer = "8"
LAYERSERIES_COMPAT_sawfish-hybris-layer = "whinlatter"
```

## meta-skipjack/conf/layer.conf
```bitbake
BBPATH .= ":${LAYERDIR}"
BBFILES += "${LAYERDIR}/recipes*/*/*.bb ${LAYERDIR}/recipes*/*/*.bbappend"
BBFILE_COLLECTIONS += "skipjack-hybris-layer"
BBFILE_PATTERN_skipjack-hybris-layer := "^${LAYERDIR}/"
BBFILE_PRIORITY:skipjack-hybris-layer = "8"
LAYERSERIES_COMPAT_skipjack-hybris-layer = "whinlatter"
```

## meta-skipjack/conf/machine/skipjack.conf
```bitbake
#@TYPE: Machine
#@NAME: Ticwatch C2+
#@DESCRIPTION: Machine configuration for the Ticwatch C2+

require conf/machine/include/arm/armv7a/tune-cortexa7.inc
require conf/machine/include/hybris-watch.inc

MACHINE_DISPLAY_ROUND = "true"
MACHINE_HAS_WLAN = "true"

PREFERRED_VERSION_android = "oreo"
PREFERRED_PROVIDER_virtual/kernel = "linux-skipjack"
PREFERRED_VERSION_linux = "3.10+pie"

IMAGE_INSTALL += "android-tools android-system underclock android-system-partition msm-fb-refresher asteroid-compass"
```

## meta-smelt/conf/layer.conf
```bitbake
BBPATH .= ":${LAYERDIR}"
BBFILES += "${LAYERDIR}/recipes*/*/*.bb ${LAYERDIR}/recipes*/*/*.bbappend"
BBFILE_COLLECTIONS += "smelt-hybris-layer"
BBFILE_PATTERN_smelt-hybris-layer := "^${LAYERDIR}/"
BBFILE_PRIORITY_smelt-hybris-layer = "8"
LAYERSERIES_COMPAT_smelt-hybris-layer = "whinlatter"
```

## meta-smelt/conf/machine/smelt.conf
```bitbake
#@TYPE: Machine
#@NAME: Moto 360 2015
#@DESCRIPTION: Machine configuration for the Moto 360 2015

require conf/machine/include/arm/armv7a/tune-cortexa7.inc
require conf/machine/include/hybris-watch.inc

MACHINE_DISPLAY_ROUND = "true"
MACHINE_DISPLAY_FLAT_TIRE = "30"
MACHINE_DISPLAY_BORDER_GESTURE_WIDTH = "0.2"
MACHINE_HAS_WLAN = "true"

PREFERRED_PROVIDER_virtual/android-system-image = "android"
PREFERRED_VERSION_android = "marshmallow"

PREFERRED_PROVIDER_virtual/kernel = "linux-smelt"
PREFERRED_VERSION_linux = "3.10+marshmallow"

IMAGE_INSTALL += "brcm-patchram-plus iproute2 wpa-supplicant underclock asteroid-hrm"
```

## meta-sparrow/conf/layer.conf
```bitbake
BBPATH .= ":${LAYERDIR}"
BBFILES += "${LAYERDIR}/recipes*/*/*.bb ${LAYERDIR}/recipes*/*/*.bbappend"
BBFILE_COLLECTIONS += "sparrow-hybris-layer"
BBFILE_PATTERN_sparrow-hybris-layer := "^${LAYERDIR}/"
BBFILE_PRIORITY_sparrow-hybris-layer = "8"
LAYERSERIES_COMPAT_sparrow-hybris-layer = "whinlatter"
```

## meta-sparrow/conf/machine/sparrow-mainline.conf
```bitbake
#@TYPE: Machine
#@NAME: Asus ZenWatch 2 on mainline
#@DESCRIPTION: Machine configuration for the Asus ZenWatch 2 with a mainline kernel

require conf/machine/include/arm/armv7a/tune-cortexa7.inc
DEFAULTTUNE = "armv7vehf-neon"
MACHINE_FEATURES = "alsa bluetooth usbgadget usbhost ext2"

SERIAL_CONSOLE = "115200 ttyHSL0"

IMAGE_FSTYPES += "ext4"
IMAGE_ROOTFS_ALIGNMENT="4"

MACHINE_HAS_WLAN = "true"
MACHINE_HAS_SPEAKER = "true"

PREFERRED_PROVIDER_virtual/kernel = "linux-sparrow-mainline"
KERNEL_DEVICETREE="qcom-apq8026-asus-sparrow.dtb"
```

## meta-sparrow/conf/machine/sparrow.conf
```bitbake
#@TYPE: Machine
#@NAME: Asus ZenWatch 2
#@DESCRIPTION: Machine configuration for the Asus ZenWatch 2

require conf/machine/include/arm/armv7a/tune-cortexa7.inc
require conf/machine/include/hybris-watch.inc

MACHINE_HAS_WLAN = "true"
MACHINE_HAS_SPEAKER = "true"

PREFERRED_VERSION_android = "lollipop"

PREFERRED_PROVIDER_virtual/kernel = "linux-sparrow"
PREFERRED_VERSION_linux = "3.10+marshmallow"

KERNEL_MODULE_AUTOLOAD += "bcmdhd"

IMAGE_INSTALL += "sensorfw-hybris-hal-plugins msm-fb-refresher brcm-patchram-plus underclock"
```

## meta-sprat/conf/layer.conf
```bitbake
BBPATH .= ":${LAYERDIR}"
BBFILES += "${LAYERDIR}/recipes*/*/*.bb ${LAYERDIR}/recipes*/*/*.bbappend"
BBFILE_COLLECTIONS += "sprat-hybris-layer"
BBFILE_PATTERN_sprat-hybris-layer := "^${LAYERDIR}/"
BBFILE_PRIORITY_sprat-hybris-layer = "8"
LAYERSERIES_COMPAT_sprat-hybris-layer = "whinlatter"
```

## meta-sprat/conf/machine/sprat.conf
```bitbake
#@TYPE: Machine
#@NAME: Samsung Gear Live
#@DESCRIPTION: Machine configuration for the Samsung Gear Live

require conf/machine/include/arm/armv7a/tune-cortexa7.inc
require conf/machine/include/hybris-watch.inc

PREFERRED_VERSION_android = "lollipop"

PREFERRED_PROVIDER_virtual/kernel = "linux-sprat"
PREFERRED_VERSION_linux = "3.10+marshmallow"

IMAGE_INSTALL += "msm-fb-refresher brcm-patchram-plus underclock"
```

## meta-sturgeon/conf/machine/dory.conf
```bitbake
#@TYPE: Machine
#@NAME: LG G Watch
#@DESCRIPTION: Machine configuration for the LG G Watch

require conf/machine/include/tune-cortexa7.inc
MACHINE_FEATURES = "apm alsa bluetooth usbgadget usbhost vfat ext2"

PREFERRED_PROVIDER_virtual/egl ?= "libhybris"
PREFERRED_PROVIDER_virtual/libgles1 ?= "libhybris"
PREFERRED_PROVIDER_virtual/libgles2 ?= "libhybris"

PREFERRED_PROVIDER_virtual/android-headers = "android"
PREFERRED_PROVIDER_virtual/android-system-image = "android"
PREFERRED_VERSION_android = "lollipop"

PREFERRED_PROVIDER_virtual/kernel = "linux-dory"
PREFERRED_VERSION_linux = "3.10+lollipop"

KERNEL_IMAGETYPE = "zImage-dtb"
IMAGE_FSTYPES += "ext2"

IMAGE_INSTALL += "android-tools android-system msm-fb-refresher brcm-patchram-plus"
```

## meta-sturgeon/conf/machine/sturgeon.conf
```bitbake
#@TYPE: Machine
#@NAME: Huawei Watch
#@DESCRIPTION: Machine configuration for the Huawei Watch

require conf/machine/include/arm/armv7a/tune-cortexa7.inc
require conf/machine/include/hybris-watch.inc

MACHINE_DISPLAY_ROUND = "true"
MACHINE_HAS_WLAN = "true"
MACHINE_HAS_SPEAKER = "true"

PREFERRED_PROVIDER_virtual/android-system-image = "android"
PREFERRED_VERSION_android = "marshmallow"

PREFERRED_PROVIDER_virtual/kernel = "linux-sturgeon"
PREFERRED_VERSION_linux = "3.10+marshmallow"

IMAGE_INSTALL += "sensorfw-hybris-hal-plugins msm-fb-refresher brcm-patchram-plus underclock asteroid-hrm"
```

## meta-swift/conf/layer.conf
```bitbake
BBPATH .= ":${LAYERDIR}"
BBFILES += "${LAYERDIR}/recipes*/*/*.bb ${LAYERDIR}/recipes*/*/*.bbappend"
BBFILE_COLLECTIONS += "swift-hybris-layer"
BBFILE_PATTERN_swift-hybris-layer := "^${LAYERDIR}/"
BBFILE_PRIORITY_swift-hybris-layer = "8"
LAYERSERIES_COMPAT_swift-hybris-layer = "warrior"
```

## meta-swift/conf/machine/swift.conf
```bitbake
#@TYPE: Machine
#@NAME: Asus Zenwatch 3
#@DESCRIPTION: Machine configuration for the Asus Zenwatch 3

require conf/machine/include/arm/armv7a/tune-cortexa7.inc
require conf/machine/include/hybris-watch.inc

MACHINE_DISPLAY_ROUND = "true"
MACHINE_HAS_SPEAKER = "true"

PREFERRED_VERSION_android = "marshmallow"

PREFERRED_PROVIDER_virtual/kernel = "linux-swift"
PREFERRED_VERSION_linux = "3.18+marshmallow"

IMAGE_INSTALL += "msm-fb-refresher udev-droid-system"
```

## meta-tetra/conf/layer.conf
```bitbake
BBPATH .= ":${LAYERDIR}"
BBFILES += "${LAYERDIR}/recipes*/*/*.bb ${LAYERDIR}/recipes*/*/*.bbappend"
BBFILE_COLLECTIONS += "tetra-hybris-layer"
BBFILE_PATTERN_tetra-hybris-layer := "^${LAYERDIR}/"
BBFILE_PRIORITY_tetra-hybris-layer = "8"
LAYERSERIES_COMPAT_tetra-hybris-layer = "whinlatter"
```

## meta-tetra/conf/machine/tetra.conf
```bitbake
#@TYPE: Machine
#@NAME: Sony Smartwatch 3
#@DESCRIPTION: Machine configuration for the Sony Smartwatch 3

require conf/machine/include/arm/armv7a/tune-cortexa7.inc
require conf/machine/include/hybris-watch.inc

MACHINE_NEEDS_BURN_IN_PROTECTION = "false"
MACHINE_HAS_WLAN = "true"

PREFERRED_VERSION_android = "marshmallow"

PREFERRED_PROVIDER_virtual/kernel = "linux-tetra"
PREFERRED_VERSION_linux = "3.10+marshmallow"

IMAGE_INSTALL += "brcm-patchram-plus underclock asteroid-compass"
```

## meta-triggerfish/conf/layer.conf
```bitbake
BBPATH .= ":${LAYERDIR}"
BBFILES += "${LAYERDIR}/recipes*/*/*.bb ${LAYERDIR}/recipes*/*/*.bbappend"
BBFILE_COLLECTIONS += "triggerfish-hybris-layer"
BBFILE_PATTERN_triggerfish-hybris-layer := "^${LAYERDIR}/"
BBFILE_PRIORITY_triggerfish-hybris-layer = "8"
LAYERSERIES_COMPAT_triggerfish-hybris-layer = "whinlatter"
```

## meta-triggerfish/conf/machine/triggerfish.conf
```bitbake
#@TYPE: Machine
#@NAME: Fossil Gen 5
#@DESCRIPTION: Machine configuration for the Fossil Gen 5 platform

require conf/machine/include/arm/armv7a/tune-cortexa7.inc
DEFAULTTUNE = "armv7vehf-neon"
require conf/machine/include/hybris-watch.inc

MACHINE_DISPLAY_ROUND = "true"
MACHINE_HAS_WLAN = "true"
MACHINE_HAS_SPEAKER = "true"

PREFERRED_PROVIDER_virtual/android-system-image = "android"
PREFERRED_VERSION_android = "armv7+pie64"

PREFERRED_PROVIDER_virtual/kernel = "linux-triggerfish"
PREFERRED_VERSION_linux = "4.9+pie"

IMAGE_INSTALL += "sensorfw-hybris-hal-plugins linux-wlan-modules-triggerfish util-linux-rfkill underclock udev-droid-system bluebinder asteroid-hrm asteroid-compass geoclue"
```

## meta-wren/conf/layer.conf
```bitbake
BBPATH .= ":${LAYERDIR}"
BBFILES += "${LAYERDIR}/recipes*/*/*.bb ${LAYERDIR}/recipes*/*/*.bbappend"
BBFILE_COLLECTIONS += "wren-hybris-layer"
BBFILE_PATTERN_wren-hybris-layer := "^${LAYERDIR}/"
BBFILE_PRIORITY_wren-hybris-layer = "8"
LAYERSERIES_COMPAT_wren-hybris-layer = "whinlatter"
```

## meta-wren/conf/machine/dory.conf
```bitbake
#@TYPE: Machine
#@NAME: LG G Watch
#@DESCRIPTION: Machine configuration for the LG G Watch

require conf/machine/include/tune-cortexa7.inc
```

## meta-wren/conf/machine/sparrow.conf
```bitbake
#@TYPE: Machine
#@NAME: Asus ZenWatch 2
#@DESCRIPTION: Machine configuration for the Asus ZenWatch 2

require conf/machine/include/tune-cortexa7.inc
MACHINE_FEATURES = "apm alsa bluetooth usbgadget usbhost vfat ext2"

PREFERRED_PROVIDER_virtual/egl ?= "libhybris"
PREFERRED_PROVIDER_virtual/libgles1 ?= "libhybris"
PREFERRED_PROVIDER_virtual/libgles2 ?= "libhybris"

PREFERRED_PROVIDER_virtual/android-headers = "android"
PREFERRED_PROVIDER_virtual/android-system-image = "android"
PREFERRED_VERSION_android = "lollipop"

PREFERRED_PROVIDER_virtual/kernel = "linux-sparrow"
PREFERRED_VERSION_linux = "3.10+marshmallow"

KERNEL_IMAGETYPE = "zImage-dtb"
IMAGE_FSTYPES += "ext2"

IMAGE_INSTALL += "android-tools android-system msm-fb-refresher brcm-patchram-plus"
```

## meta-wren/conf/machine/wren.conf
```bitbake
#@TYPE: Machine
#@NAME: Asus ZenWatch 2
#@DESCRIPTION: Machine configuration for the Asus ZenWatch 2

require conf/machine/include/arm/armv7a/tune-cortexa7.inc
DEFAULTTUNE = "armv7vehf-neon"
require conf/machine/include/hybris-watch.inc

MACHINE_HAS_WLAN = "true"

PREFERRED_VERSION_android = "marshmallow"

PREFERRED_PROVIDER_virtual/kernel = "linux-wren"
PREFERRED_VERSION_linux = "3.10+marshmallow"

KERNEL_MODULE_AUTOLOAD += "bcmdhd"

IMAGE_INSTALL += "sensorfw-hybris-hal-plugins msm-fb-refresher brcm-patchram-plus"
```

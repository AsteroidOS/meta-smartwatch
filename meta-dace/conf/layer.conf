## meta-dace/conf/layer.conf
```bitbake
BBPATH .= ":${LAYERDIR}"
BBFILES += "${LAYERDIR}/recipes*/*/*.bb ${LAYERDIR}/recipes*/*/*.bbappend"
BBFILE_COLLECTIONS += "dace-hybris-layer"
BBFILE_PATTERN_dace-hybris-layer := "^${LAYERDIR}/"
BBFILE_PRIORITY_dace-hybris-layer = "8"
LAYERSERIES_COMPAT_dace-hybris-layer = "walnascar"
```

## meta-emulator/conf/machine/emulator-arm64.conf
```bitbake
#@TYPE: Machine
#@NAME: emulator-arm64
#@DESCRIPTION: Machine configuration for the aarch64 Qemu-based emulator.

require conf/machine/qemuarm64.conf
MACHINEOVERRIDES =. "qemuarm64:emulator:"

MACHINE_FEATURES:append = " alsa ext2 "

IMAGE_FSTYPES:append = " ext4 "
IMAGE_ROOTFS_ALIGNMENT = "4"

MACHINE_DISPLAY_ROUND = "false"
MACHINE_HAS_WLAN = "false"
MACHINE_HAS_SPEAKER = "true"
MACHINE_HAS_MICROPHONE = "false"

KMACHINE = "qemuarm64"
PREFERRED_PROVIDER_virtual/kernel = "linux-yocto"
MACHINE_ESSENTIAL_EXTRA_RDEPENDS:append = " kernel-modules "
MACHINE_ESSENTIAL_EXTRA_RECOMMENDS:append = " kernel-modules "
```
